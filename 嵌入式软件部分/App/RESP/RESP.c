/*********************************************************************************************************
* 模块名称：RESP.c
* 文件说明：呼吸（RESP）信号处理模块
*           完成呼吸信号滤波、呼吸率计算、导联状态判断及显示输出
* 当前版本：1.0.0
* 作    者：Chill
* 完成日期：2026-02-06
*********************************************************************************************************/

/*********************************************************************************************************
*                                           头文件包含
*********************************************************************************************************/
#include "stm32f10x_conf.h"
#include "string.h"
#include "RESP.h"
#include "math.h"
#include "UART1.h"
#include "OLED.h"
#include "Timer.h"

/*********************************************************************************************************
*                                           宏定义
*********************************************************************************************************/
#define N 2               // IIR 滤波器阶数（二阶）
#define SmoothWindowsLen 200    // 平滑滤波窗口长度
#define BR_WAVE_LEN 1800  // 呼吸波形阈值计算窗口长度

/*********************************************************************************************************
*                                           内部变量
*********************************************************************************************************/
/*
 * IIR 滤波器差分方程：
 * y[n] = b0*x[n] + b1*x[n-1] + b2*x[n-2] - a1*y[n-1] - a2*y[n-2]
 */

// 呼吸率计算相关变量
static double arr_BR_Wave[BR_WAVE_LEN] = {0}; // 呼吸波形缓存
static int BR_Wave_index = 0;                 // 波形索引
static double peakThreshold = 0;              // 峰值检测阈值
static double lastPeak_index = 0;              // 上一次峰值时间
static double currentPeak_index = 0;           // 当前峰值时间
static int breathRate = 0;                     // 呼吸率（BPM）

// 导联状态判断（峰峰值）
static double s_peak2peak = 0;

/*********************************************************************************************************
*                                           内部函数声明
*********************************************************************************************************/
static double SmoothingFilter(double NewData);              // 平滑滤波

static void Update_Threshold(double *data_window, int windowSize, double *threshold_output); // 阈值更新
static void calRate(double ppdistance, int *rate_output);   // 呼吸率计算

/*********************************************************************************************************
*                                           内部函数实现
*********************************************************************************************************/
/*********************************************************************************************************
* 函数名称：滑动平均平滑滤波
* 函数功能：对输入数据进行滑动平均平滑滤波
* 输入参数：void
* 输出参数：void
* 返 回 值：void
* 创建日期：2026年04月16日
* 注    意：
*********************************************************************************************************/
static double SmoothingFilter(double newData)
{
  static double buf[SmoothWindowsLen] = {0};
  static int idx = 0;
  static int count = 0;
  static double sum = 0;

  sum -= buf[idx];
  buf[idx] = newData;
  sum += newData;

  idx++;
  if(idx >= SmoothWindowsLen) idx = 0;
  if(count < SmoothWindowsLen) count++;

  return sum / count;
}

/*********************************************************************************************************
* 函数名称：更新峰值检测阈值
* 函数功能：根据输入数据更新呼吸信号的峰值检测阈值
* 输入参数：void
* 输出参数：void
* 返 回 值：void
* 创建日期：2026年04月16日
* 注    意：
*********************************************************************************************************/
static void Update_Threshold(double *data_window, int windowSize, double *threshold_output)
{
  int i;
  double peakMax = 0.0;
  double peakMin = 4095.0;

  for(i = 1; i < windowSize; i++)
  {
    if(data_window[i] > peakMax) peakMax = data_window[i];
    if(data_window[i] < peakMin) peakMin = data_window[i];
  }

  s_peak2peak = peakMax - peakMin;  // 更新峰峰值
  *threshold_output = peakMax - (peakMax - peakMin) / 4;
}

/*********************************************************************************************************
* 函数名称：根据峰间距计算呼吸率
* 函数功能：根据输入的峰间距计算呼吸率（BPM）
* 输入参数：void
* 输出参数：void
* 返 回 值：void
* 创建日期：2026年04月16日
* 注    意：
*********************************************************************************************************/
static void calRate(double ppdistance, int *rate_output)
{
  *rate_output = (int)(60000.0 / ppdistance); // ppdistance：ms
}

/*********************************************************************************************************
*                                           API函数
*********************************************************************************************************/
/*********************************************************************************************************
* 函数名称：初始化RESP模块
* 函数功能：初始化RESP模块
* 输入参数：void
* 输出参数：void
* 返 回 值：void
* 创建日期：2026年04月16日
* 注    意：
*********************************************************************************************************/
void InitRESP(void)
{
  memset(arr_BR_Wave, 0, sizeof(arr_BR_Wave));
  BR_Wave_index = 0;
  peakThreshold = 0;
  lastPeak_index = 0;
  currentPeak_index = 0;
  breathRate = 0;

  s_peak2peak = 0;
}

/*********************************************************************************************************
* 函数名称：RESP实时处理任务
* 函数功能：对输入的ECG信号进行实时处理，包括滤波、阈值更新、峰值检测和呼吸率计算
* 输入参数：void
* 输出参数：void
* 返 回 值：void
* 创建日期：2026年04月16日
* 注    意：
*********************************************************************************************************/
int RESPTask(u16 inp)
{
  double output1 = 0;

  // 信号处理链：陷波 → 低通 → 平滑
  output1 = SmoothingFilter(inp);

  // 保存波形数据
  arr_BR_Wave[BR_Wave_index++] = output1;

  // 波形缓存满，更新阈值
  if(BR_Wave_index >= BR_WAVE_LEN)
  {
    BR_Wave_index = 0;
    Update_Threshold(arr_BR_Wave, BR_WAVE_LEN, &peakThreshold);
  }

  // 峰值检测（上升沿过阈）
  if((BR_Wave_index > 1) && (BR_Wave_index < BR_WAVE_LEN - 1))
  {
    if((arr_BR_Wave[BR_Wave_index - 2] <= peakThreshold) &&
       (arr_BR_Wave[BR_Wave_index - 1] >= peakThreshold))
    {
      currentPeak_index = GetTimeCounter();
      calRate(currentPeak_index - lastPeak_index, &breathRate);
      lastPeak_index = currentPeak_index;
    }
  }

  return (u16)output1;
}

/*********************************************************************************************************
* 函数名称：获取呼吸率
* 函数功能：获取当前呼吸率（BPM）
* 输入参数：void
* 输出参数：void
* 返 回 值：void
* 创建日期：2026年04月16日
* 注    意：
*********************************************************************************************************/
u16   RESPGetRespRate(void)   //获取呼吸率
{
	return (u16)breathRate;
}

/*********************************************************************************************************
* 函数名称：获取导联状态
* 函数功能：根据当前峰峰值判断导联状态
* 输入参数：void
* 输出参数：void
* 返 回 值：void
* 创建日期：2026年04月16日
* 注    意：0-导联脱落，1-导联正常
*********************************************************************************************************/
u8   RESPGetLeadStatus(void) //获取导联状态
{
  u8 leadFlag;
  if(s_peak2peak < 600 || s_peak2peak > 3000)
  {
    leadFlag = 0;
  }
  else
  {
    leadFlag = 1;
  }
  return leadFlag;
}

/*********************************************************************************************************
* 函数名称：OLED显示呼吸信息
* 函数功能：在OLED上显示当前呼吸率（BPM）和导联状态
* 输入参数：void
* 输出参数：void
* 返 回 值：void
* 创建日期：2026年04月16日
* 注    意：
*********************************************************************************************************/
void OLED_RESP(void)
{
  OLEDShowString(0, 32, (u8*)"BR:");
  OLEDShowString(64, 32, (u8*)"BPM");
  OLEDShowString(0, 48, (u8*)"RESP_LEAD:");

  // 导联异常
  if(s_peak2peak < 600 || s_peak2peak > 3000)
  {
    OLEDShowString(88, 48, (u8*)"Noob");
    OLEDShowString(32, 32, (u8*)"Err");
    // printf("[[2,Err]]\r\n");
  }
  else
  {
    OLEDShowString(88, 48, (u8*)"Good");

    // 呼吸率合理
    if(breathRate >= 5 && breathRate <= 100)
    {
      OLEDShowNum(32, 32, breathRate, 3, 16);
    }
    else
    {
      OLEDShowString(32, 32, (u8*)"Err");
    }
  }
}
